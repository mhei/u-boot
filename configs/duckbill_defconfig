## configs/duckbill_defconfig
```kconfig
CONFIG_ARM=y
CONFIG_TARGET_DUCKBILL=y
CONFIG_SPL=y
# CONFIG_CMD_IMLS is not set
# CONFIG_CMD_FLASH is not set
# CONFIG_SPI_FLASH is not set
# CONFIG_CMD_FPGA is not set
CONFIG_CMD_PING=y
```
